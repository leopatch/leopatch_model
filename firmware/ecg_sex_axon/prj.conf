## CMakeLists.txt
```
cmake_minimum_required(VERSION 3.20.0)

# The Axon NPU driver comes from the Edge AI Add-on, used as an extra Zephyr module.
if(NOT DEFINED EXTRA_ZEPHYR_MODULES AND NOT DEFINED ENV{EXTRA_ZEPHYR_MODULES})
  if(DEFINED ENV{EDGE_AI_ADDON_DIR})
    set(EXTRA_ZEPHYR_MODULES $ENV{EDGE_AI_ADDON_DIR})
  else()
    set(EXTRA_ZEPHYR_MODULES /opt/nordic/ncs/sdk-edge-ai)
  endif()
endif()

find_package(Zephyr REQUIRED HINTS $ENV{ZEPHYR_BASE})
project(ecg_sex_axon)

target_sources(app PRIVATE
    src/main.c
    src/frontend.c
)
```

## prj.conf
```kconfig
CONFIG_NRF_AXON=y

# Must be >= NRF_AXON_MODEL_ECG_SEX_V3_MAX_IL_BUFFER_USED in the generated model header
CONFIG_NRF_AXON_INTERLAYER_BUFFER_SIZE=323072

# The model is compiled without the partial sum buffer
CONFIG_NRF_AXON_PSUM_BUFFER_SIZE=0

CONFIG_FPU=y
CONFIG_LOG=y
CONFIG_CBPRINTF_FP_SUPPORT=y
CONFIG_MAIN_STACK_SIZE=4096
```

## boards/nrf54lm20dk_nrf54lm20b_cpuapp.overlay
```dts
&axon {
	status = "okay";
};
```

## src/main.c
```c
/*
 * ECG sex classifier on the nRF54LM20B: the CPU runs the front end (stem + max-pool),
 * the Axon NPU runs the rest. Runs the test ECGs embedded by deploy/export_axon_model.py
 * and checks the results against the Python int8 reference.
 */
#include <assert.h>
#include <math.h>

#include <zephyr/kernel.h>
#include <zephyr/logging/log.h>

#include <axon/nrf_axon_platform.h>
#include <drivers/axon/nrf_axon_driver.h>
#include <drivers/axon/nrf_axon_nn_infer.h>

#include "frontend.h"
#include "generated/nrf_axon_model_ecg_sex_v3_.h"
#include "generated/test_ecgs.h"

LOG_MODULE_REGISTER(ecg_sex);

#define MODEL model_ecg_sex_v3

/* Allowed logit difference to the Python int8 reference (front end float rounding). */
#define LOGIT_TOLERANCE 0.25f

static int8_t npu_input[FRONTEND_OUT_CH * FRONTEND_OUT_LEN];
static int8_t npu_output[NRF_AXON_MODEL_ECG_SEX_V3_PACKED_OUTPUT_SIZE] __aligned(4);

static float dequantize(int8_t q, const nrf_axon_compiled_model_output_s *out)
{
	return (float)(q - out->dequant_zp) * ldexpf((float)out->dequant_mult, -out->dequant_round);
}

int main(void)
{
	const nrf_axon_nn_compiled_model_input_s *in = &MODEL.inputs[0];
	const nrf_axon_nn_model_layer_dimensions_s *dims = &in->dimensions;
	nrf_axon_result_e result;
	int passed = 0;

	LOG_INF("ECG sex classifier, model %s on Axon NPU", MODEL.model_name);

	if (dims->height * dims->width * dims->channel_cnt != sizeof(npu_input) ||
	    dims->byte_width != 1 || MODEL.outputs[0].dimensions.byte_width != 1) {
		LOG_ERR("Model input/output does not match the front end");
		return -1;
	}

	result = nrf_axon_platform_init();
	if (result != NRF_AXON_RESULT_SUCCESS) {
		LOG_ERR("Axon NPU platform initialization failed, err %d", result);
		return -1;
	}

	if (nrf_axon_nn_model_init_vars(&MODEL)) {
		LOG_ERR("Model persistent variables initialization failed");
		return -1;
	}

	result = nrf_axon_nn_model_validate(&MODEL);
	if (result != NRF_AXON_RESULT_SUCCESS) {
		LOG_ERR("Model validation failed, err %d", result);
		return -1;
	}

	const float inv_scale = ldexpf((float)in->quant_mult, -in->quant_round);

	for (int i = 0; i < TEST_ECG_COUNT; i++) {
		const uint32_t t0 = k_cycle_get_32();

		frontend_run(test_ecg[i], npu_input, inv_scale, in->quant_zp);

		const uint32_t t1 = k_cycle_get_32();

		result = nrf_axon_nn_model_infer_sync(&MODEL, npu_input, npu_output);

		const uint32_t t2 = k_cycle_get_32();

		if (result != NRF_AXON_RESULT_SUCCESS) {
			LOG_ERR("Inference failed, err %d", result);
			return -1;
		}

		const float logit = dequantize(npu_output[0], &MODEL.outputs[0]);
		const float prob = 1.0f / (1.0f + expf(-logit));
		const bool ok = fabsf(logit - test_ecg_logit_int8[i]) <= LOGIT_TOLERANCE;

		passed += ok;
		LOG_INF("ECG %d: p(label 1) %.3f -> label %d | logit %.3f, int8 ref %.3f, float ref %.3f %s",
			i, (double)prob, prob >= MODEL_VAL_THRESHOLD, (double)logit,
			(double)test_ecg_logit_int8[i], (double)test_ecg_logit_float[i],
			ok ? "OK" : "MISMATCH");
		LOG_INF("       CPU front end %u ms, NPU %u ms", k_cyc_to_ms_near32(t1 - t0),
			k_cyc_to_ms_near32(t2 - t1));
	}

	LOG_INF("%d/%d ECGs match the Python reference", passed, TEST_ECG_COUNT);
	return 0;
}
```

## src/frontend.c
```c
#include <math.h>

#include <zephyr/sys/util.h>

#include "frontend.h"
#include "generated/frontend_params.h"

#define PAD      ((FRONTEND_STEM_KERNEL - 1) / 2) /* stem conv padding (7) */
#define STEM_LEN (FRONTEND_IN_LEN / 2)            /* stride-2 stem output (2500) */
#define POOL_LEN (STEM_LEN / 2)                   /* stride-2 max-pool output (1250) */

BUILD_ASSERT(POOL_LEN == 2 * FRONTEND_OUT_LEN);
BUILD_ASSERT(FRONTEND_OUT_CH == 2 * FRONTEND_STEM_CHANNELS);

/* Normalized ECG with PAD zeros on each side, so the stem conv needs no bounds checks. */
static float x_pad[FRONTEND_IN_LEN + 2 * PAD];

/* Per-ECG z-score, as in MIMICECGSingleLeadDataset. */
static void normalize(const float *raw)
{
	float *x = &x_pad[PAD];
	double sum = 0.0;
	double var = 0.0;

	for (int i = 0; i < FRONTEND_IN_LEN; i++) {
		x[i] = isfinite(raw[i]) ? raw[i] : 0.0f;
		sum += (double)x[i];
	}

	const float mean = (float)(sum / FRONTEND_IN_LEN);

	for (int i = 0; i < FRONTEND_IN_LEN; i++) {
		const float d = x[i] - mean;

		var += (double)(d * d);
	}

	float std = (float)sqrt(var / FRONTEND_IN_LEN);

	if (std < 1e-6f) {
		std = 1.0f;
	}
	for (int i = 0; i < FRONTEND_IN_LEN; i++) {
		x[i] = (x[i] - mean) / std;
	}
}

/* ReLU(BN(conv)) of all stem channels at stem output sample n. */
static void stem(int n, float *z)
{
	const float *xs = &x_pad[2 * n];

	for (int c = 0; c < FRONTEND_STEM_CHANNELS; c++) {
		float acc = frontend_stem_b[c];

		for (int k = 0; k < FRONTEND_STEM_KERNEL; k++) {
			acc += frontend_stem_w[c][k] * xs[k];
		}
		z[c] = acc > 0.0f ? acc : 0.0f;
	}
}

void frontend_run(const float *raw, int8_t *out, float inv_scale, int8_t zero_point)
{
	/* stem outputs 2m - 1, 2m and 2m + 1. Stem output -1 is padding: 0 is safe after ReLU. */
	float prev[FRONTEND_STEM_CHANNELS] = {0};
	float z0[FRONTEND_STEM_CHANNELS];
	float z1[FRONTEND_STEM_CHANNELS];

	normalize(raw);

	for (int m = 0; m < POOL_LEN; m++) {
		stem(2 * m, z0);
		stem(2 * m + 1, z1);

		const int phase = m & 1;
		int8_t *dst = &out[phase * FRONTEND_STEM_CHANNELS * FRONTEND_OUT_LEN + (m >> 1)];

		for (int c = 0; c < FRONTEND_STEM_CHANNELS; c++) {
			const float pooled = fmaxf(prev[c], fmaxf(z0[c], z1[c]));
			const int32_t q = (int32_t)lrintf(pooled * inv_scale) + zero_point;

			dst[c * FRONTEND_OUT_LEN] = (int8_t)CLAMP(q, INT8_MIN, INT8_MAX);
			prev[c] = z1[c];
		}
	}
}
```

## src/frontend.h
```c
/*
 * CPU front end of the ECG sex classifier: z-score normalization, stem conv + BN + ReLU and
 * max-pool. Mirrors frontend() in deploy/export_axon_model.py.
 */
#pragma once

#include <stdint.h>

#define FRONTEND_IN_LEN  5000 /* 10 s at 500 Hz */
#define FRONTEND_OUT_CH  128  /* 2 phases x 64 stem channels */
#define FRONTEND_OUT_LEN 625  /* 1250 pooled samples / 2 phases */

/**
 * Run the front end on one raw single-lead ECG and quantize the result for the NPU.
 *
 * @param raw        FRONTEND_IN_LEN raw samples (non-finite values are treated as 0).
 * @param out        int8 NPU input, packed channel-first: out[ch * FRONTEND_OUT_LEN + m] holds
 *                   pooled sample 2 * m + phase of stem channel c, where ch = phase * 64 + c.
 * @param inv_scale  1 / input scale of the compiled model.
 * @param zero_point Input zero point of the compiled model.
 */
void frontend_run(const float *raw, int8_t *out, float inv_scale, int8_t zero_point);
```
